## nrf_security/src/drivers/zephyr/Kconfig
```kconfig
#
# Copyright (c) 2023 Nordic Semiconductor
#
# SPDX-License-Identifier: LicenseRef-Nordic-5-Clause
#

config PSA_CRYPTO_DRIVER_ENTROPY_ZEPHYR
	bool
	default y
	# Only Oberon PSA core supports generate random through driver interface.
	depends on PSA_CORE_OBERON
	depends on !PSA_CRYPTO_DRIVER_GENERATE_RANDOM_CC3XX_PLATFORM
	depends on PSA_WANT_GENERATE_RANDOM
```
